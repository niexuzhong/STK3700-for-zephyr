## boards/arm/efm32gg_slstk3700/Kconfig.board
```kconfig
# Kconfig - EFM32HG SLSTK3400A board
#
# Copyright (c) 2018, Marcio Montenegro
#
# SPDX-License-Identifier: Apache-2.0
#

config BOARD_EFM32GG_SLSTK3700
	bool "SiLabs EFM32GG-SLSTK3700 (Gaint Gecko)"
	depends on SOC_SERIES_EFM32GG
	select SOC_PART_NUMBER_EFM32GG990F1024
```

## boards/arm/efm32gg_slstk3700/Kconfig.defconfig
```kconfig
# Kconfig - EFM32HG SLSTK3400A board
#
# Copyright (c) 2018, Marcio Montenegro
#
# SPDX-License-Identifier: Apache-2.0
#

if BOARD_EFM32GG_SLSTK3700

config BOARD
	default "efm32gg_slstk3700"

config CMU_HFXO_FREQ
	default 48000000

config CMU_LFXO_FREQ
	default 32768

if GPIO_GECKO

config GPIO_GECKO_PORTA
	default y

config GPIO_GECKO_PORTB
	default y

config GPIO_GECKO_PORTC
	default n

config GPIO_GECKO_PORTD
	default n

config GPIO_GECKO_PORTE
	default y

config GPIO_GECKO_PORTF
	default y

endif # GPIO_GECKO

endif # BOARD_EFM32GG_SLSTK3700
```

## soc/arm/silabs_exx32/Kconfig.soc
```kconfig
#
# Copyright (c) 2017 Christian Taedcke
#
# SPDX-License-Identifier: Apache-2.0
#

source "$(SOC_DIR)/arm/silabs_exx32/*/Kconfig.series"
```

## soc/arm/silabs_exx32/efm32gg/Kconfig.defconfig.series
```kconfig
# Kconfig - EFM32WG series configuration options

#
# Copyright (c) 2017 Christian Taedcke
#
# SPDX-License-Identifier: Apache-2.0
#

if SOC_SERIES_EFM32GG

config SOC_SERIES
	default "efm32gg"

config SOC_PART_NUMBER
	default "EFM32GG990F1024" if SOC_PART_NUMBER_EFM32GG990F1024

config NUM_IRQS
	int
	# must be >= the highest interrupt number used
	default 38

source "$(SOC_DIR)/arm/silabs_exx32/efm32gg/Kconfig.defconfig.efm32gg"

endif # SOC_SERIES_EFM32GG
```

## soc/arm/silabs_exx32/efm32gg/Kconfig.soc
```kconfig
# Kconfig - EFM32WG (Wonder Gecko) MCU line
#
# Copyright (c) 2017 Christian Taedcke
#
# SPDX-License-Identifier: Apache-2.0
#

if SOC_SERIES_EFM32GG

config SOC_PART_NUMBER_EFM32GG990F1024
	bool

endif # SOC_SERIES_EFM32GG
```
